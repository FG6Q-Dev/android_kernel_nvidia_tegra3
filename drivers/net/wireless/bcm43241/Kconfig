## drivers/net/wireless/bcm43241/Kconfig
```kconfig
config BCM43241
	tristate "Broadcom 43241 wireless card support"
	depends on MMC
	---help---
	  This module adds support for wireless adapters based on
	  Broadcom 43241 chipset.

	  This driver uses the kernel's cfg80211 subsystem.

	  If you choose to build a module, it'll be called dhd. Say M if
	  unsure.

config BCM43241_FW_PATH
	depends on BCM43241
	string "Firmware path"
	default "/system/vendor/firmware/fw_bcmdhd.bin"
	---help---
	  Path to the firmware file.

config BCM43241_NVRAM_PATH
	depends on BCM43241
	string "NVRAM path"
	default "/system/etc/wifi/bcmdhd.cal"
	---help---
	  Path to the calibration file.

config BCM43241_EDP_SUPPORT
	bool "BCM43241 EDP Support"
	depends on BCM43241 && EDP_FRAMEWORK
	help
	  Use BCM43241 EDP Support to register the driver to
	  battery edp manager.

config DHD_USE_STATIC_BUF
	bool "Enable memory preallocation"
	depends on BCM43241
	default n
	---help---
	  Use memory preallocated in platform

config DHD_USE_SCHED_SCAN
	bool "Use CFG80211 sched scan"
	depends on BCM43241 && CFG80211
	default n
	---help---
	  Use CFG80211 sched scan

config BCM43241_CUSTOM_REGULATORY_DOMAIN
	bool "Enable Custom Regulatory Domain"
	depends on BCM43241
	default y
	---help---
	Use Custom Regulatory Domain set by driver.

config BCM43241_DISABLE_P2P_SYSFS_DEVICE_NODE
	bool "Disable sysfs entry for P2P interfaces"
	depends on BCM43241
	default n
	---help---
	Disable creation of sysfs device node for P2P interfaces.
	This is a workaround to prevent management tools from
	directly managing P2P virtual devices.

config BCM43241_CLAIM_BCM4325_SDGWB
	bool "Claim BCM4325 SDGWB"
	depends on BCM43241
	default y
	---help---
	Claim BCM4325 SDGWB

config BCM43241_CLAIM_BCM4325
	bool "Claim BCM4325"
	depends on BCM43241
	default y
	---help---
	Claim BCM4325

config BCM43241_CLAIM_BCM4319
	bool "Claim BCM4319"
	depends on BCM43241
	default y
	---help---
	Claim BCM4319

config BCM43241_CLAIM_BCM4330
	bool "Claim BCM4330"
	depends on BCM43241
	default y
	---help---
	Claim BCM4330

config BCM43241_CLAIM_BCM4334
	bool "Claim BCM4334"
	depends on BCM43241
	default y
	---help---
	Claim BCM4334

config BCM43241_CLAIM_BCM4324
	bool "Claim BCM4324"
	depends on BCM43241
	default y
	---help---
	Claim BCM4324

config BCM43241_CLAIM_BCM43239
	bool "Claim BCM43239"
	depends on BCM43241
	default y
	---help---
	Claim BCM43239

config BCM43241_CLAIM_SDIO_CLASS_NONE
	bool "Claim SDIO chip with no class"
	depends on BCM43241
	default y
	---help---
	Claim SDIO chip with no class
```
